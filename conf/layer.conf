## conf/layer.conf
```bitbake
# We have a conf and classes directory, add to BBPATH
BBPATH .= ":${LAYERDIR}"

# We have a recipes directory containing .bb and .bbappend files, add to BBFILES
BBFILES += "${LAYERDIR}/recipes-*/*/*.bb \
            ${LAYERDIR}/recipes-*/*/*.bbappend"

BBFILE_COLLECTIONS += "fotahub-examples"
BBFILE_PATTERN_fotahub-examples = "^${LAYERDIR}/"
BBFILE_PRIORITY_fotahub-examples = "10"

LAYERDEPENDS_fotahub-examples = "fotahub"
LAYERSERIES_COMPAT_fotahub-examples = "dunfell"

# The dynamic-layers directory hosts the extensions and layer specific
# modifications.
#
# The .bbappend and .bb files are included if the respective layer
# collection is available.
BBFILES += "${@' '.join('${LAYERDIR}/dynamic-layers/%s/recipes*/*/*.bbappend' % layer \
               for layer in BBFILE_COLLECTIONS.split())}"
BBFILES += "${@' '.join('${LAYERDIR}/dynamic-layers/%s/recipes*/*/*.bb' % layer \
               for layer in BBFILE_COLLECTIONS.split())}"

BBFILES_DYNAMIC += " \
    raspberrypi:${LAYERDIR}/dynamic-layers/raspberrypi-layer/*/*/*.bb \
    raspberrypi:${LAYERDIR}/dynamic-layers/raspberrypi-layer/*/*/*.bbappend \
"

BBMASK += " \
    /meta-updater-raspberrypi/recipes-bsp/bootfiles/bootfiles.bbappend \
    /meta-updater-raspberrypi/recipes-bsp/u-boot-otascript/ \
"
```
